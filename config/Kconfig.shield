## config/Kconfig.shield
```kconfig
config SHIELD_MADTRIX_LEFT
    def_bool $(shields_list_contains,madtrix_left)

config SHIELD_MADTRIX_RIGHT
    def_bool $(shields_list_contains,madtrix_right)
```

## config/boards/shields/madtrix/Kconfig.defconfig
```kconfig
if SHIELD_MADTRIX_DONGLE

config ZMK_KEYBOARD_NAME
    default "Madtrix"

config ZMK_SPLIT_BLE_ROLE_CENTRAL
    default y

config ZMK_USB
	default y

choice ZMK_DISPLAY_WORK_QUEUE
    default ZMK_DISPLAY_WORK_QUEUE_DEDICATED
endchoice

endif 

if SHIELD_MADTRIX_LEFT || SHIELD_MADTRIX_RIGHT || SHIELD_MADTRIX_DONGLE

config ZMK_SPLIT
    default y

config ZMK_BLE
	default y


endif

if ZMK_DISPLAY

config I2C
    default y

config SSD1306
    default y

endif # ZMK_DISPLAY
```

## config/west.yml
```yaml
manifest:
  remotes:
    - name: zmkfirmware
      url-base: https://github.com/alescito
  projects:
    - name: zmk
      remote: zmkfirmware
```

## dts/bindings/behaviors/alescito,behavior-kvm.yaml
```yaml
description: Behavior to control GPIOs (LEDs)

compatible: "alescito,behavior-kvm"

include: two_param.yaml
```
