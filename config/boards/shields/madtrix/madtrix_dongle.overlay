/*
 * Copyright (c) 2020 Pete Johanson, Kurtis Lew
 *
 * SPDX-License-Identifier: MIT
 */

#include "madtrix.dtsi"

&default_transform {
	col-offset = <5>;
};

&kscan0 {
	col-gpios
		= <&pro_micro 21 GPIO_ACTIVE_HIGH>
		, <&pro_micro 20 GPIO_ACTIVE_HIGH>
		, <&pro_micro 19 GPIO_ACTIVE_HIGH>
		, <&pro_micro 18 GPIO_ACTIVE_HIGH>
		, <&pro_micro 10 GPIO_ACTIVE_HIGH>
		;
};
// Put this in the overlay of the central side (usually left).
// The mouse driver doesn't work on the peripheral.
// If you have your trackpoint on the right side, you need to
// make it the central side first.
//
// Check the Kconfig.defconfig and the `ZMK_SPLIT_ROLE_CENTRAL`
// setting.
&pro_micro_i2c {
    status = "okay";

    oled: ssd1306@3c {
        compatible = "solomon,ssd1306fb";
        reg = <0x3c>;
        width = <128>;
        height = <64>;
        segment-offset = <0>;
        page-offset = <0>;
        display-offset = <0>;
        multiplex-ratio = <63>;
        segment-remap;
        com-invdir;
        inversion-on;
        prechargep = <0x22>;
    };
};
